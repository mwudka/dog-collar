## CMakeLists.txt
```
cmake_minimum_required(VERSION 3.8.2)

# This sample runs as a non-secure application on nRF91. Therefore, it
# requires the secure_partition_manager that prepares the required
# peripherals to be available for the application.
#
# Configure the SPM image to enable the peripherals that this sample
# needs.
set(spm_CONF_FILE
  prj.conf
  ${CMAKE_CURRENT_LIST_DIR}/child_secure_partition_manager.conf
  )

set(CMAKE_MODULE_PATH "${CMAKE_SOURCE_DIR}/nanopb/extra")
find_package(Nanopb REQUIRED)

include_directories(${NANOPB_INCLUDE_DIRS})

nanopb_generate_cpp(PROTO_SRCS PROTO_HDRS RELPATH ../proto
  ../proto/dogcollar.proto )
  
include_directories(${CMAKE_CURRENT_BINARY_DIR})
set_source_files_properties(${PROTO_SRCS} ${PROTO_HDRS}
    PROPERTIES GENERATED TRUE)

include($ENV{ZEPHYR_BASE}/../nrf/cmake/boilerplate.cmake NO_POLICY_SCOPE)
include($ENV{ZEPHYR_BASE}/cmake/app/boilerplate.cmake NO_POLICY_SCOPE)
project(dog-collar)

# NORDIC SDK APP START
target_sources(app PRIVATE src/main.c)
# NORDIC SDK APP END
zephyr_include_directories(src)

target_sources(app PRIVATE 
  src/ble.c
  src/gps.c
  src/battery_monitor.c
  src/activity_tracker.c
  src/server_upload.c
  src/vendor/croaring/roaring.c
  ${PROTO_SRCS} ${PROTO_HDRS}
)
```

## prj.conf
```kconfig
CONFIG_NEWLIB_LIBC=y
CONFIG_ASSERT=n
CONFIG_REBOOT=y

CONFIG_DEBUG=y

CONFIG_LOG=y
CONFIG_LOG_IMMEDIATE=y

# Network
CONFIG_NETWORKING=y
CONFIG_NET_IPV4=y
CONFIG_NET_TCP=y
CONFIG_NET_NATIVE=n
CONFIG_NET_SOCKETS=y
CONFIG_NET_SOCKETS_POSIX_NAMES=y
CONFIG_NET_SOCKETS_POLL_MAX=4
CONFIG_NET_SOCKETS_OFFLOAD=y
CONFIG_NET_LOG=y
CONFIG_NET_SOCKETS_LOG_LEVEL_DBG=n

CONFIG_NEWLIB_LIBC_FLOAT_PRINTF=y

# LTE link control
CONFIG_LTE_LINK_CONTROL=y
CONFIG_LTE_NETWORK_MODE_LTE_M_GPS=y
CONFIG_LTE_AUTO_INIT_AND_CONNECT=n
CONFIG_LTE_LINK_CONTROL_LOG_LEVEL_DBG=y

CONFIG_LTE_NETWORK_MODE_NBIOT=n
CONFIG_LTE_LEGACY_PCO_MODE=n
CONFIG_LTE_PSM_REQ_RPTAU="00000110"
CONFIG_LTE_PSM_REQ_RAT="00000000"

CONFIG_LTE_LOCK_BANDS=y
# Enable band 2, 3, 4, 8, 12, 13 ,20 and 28
CONFIG_LTE_LOCK_BAND_MASK="1000000010000001100010001110"


CONFIG_SPI_NRFX_SPIM_MISO_NO_PULL=y

# GPS
CONFIG_NRF9160_GPS_LOG_LEVEL_DBG=y
CONFIG_NRF9160_GPS=y
CONFIG_NRF9160_GPS_LOG_LEVEL_DBG=y
CONFIG_GPS_USE_EXTERNAL=y
CONFIG_GPS_DEV_NAME="NRF9160_GPS"
CONFIG_NRF9160_GPS_NMEA_GSV=y
CONFIG_NRF9160_GPS_NMEA_GLL=y
CONFIG_NRF9160_GPS_NMEA_GGA=y
CONFIG_NRF9160_GPS_NMEA_RMC=y

# AT host
CONFIG_AT_HOST_LIBRARY=y

# BSD library
CONFIG_BSD_LIBRARY=y

# Disable Modem traces, since we need UART1 for HCI
CONFIG_BSD_LIBRARY_TRACE_ENABLED=n


# Console for user association
CONFIG_CONSOLE_SUBSYS=y
CONFIG_CONSOLE_GETCHAR=y

CONFIG_BT_H4=y
CONFIG_BT_WAIT_NOP=y

CONFIG_MODEM_INFO=y

CONFIG_BT=y
CONFIG_BT_DEBUG_LOG=y
CONFIG_BT_SMP=n
CONFIG_BT_PERIPHERAL=y
CONFIG_BT_GATT_DIS=y
CONFIG_BT_ATT_PREPARE_COUNT=5
CONFIG_BT_GATT_BAS=y
CONFIG_BT_DEVICE_NAME="Thingy91"
CONFIG_BT_DEVICE_APPEARANCE=833
CONFIG_BT_DEVICE_NAME_DYNAMIC=y
CONFIG_BT_DEVICE_NAME_MAX=65

CONFIG_UART_1_NRF_UARTE=y
CONFIG_UART_1_NRF_FLOW_CONTROL=y
CONFIG_BT_UART_ON_DEV_NAME="UART_1"
CONFIG_UART_INTERRUPT_DRIVEN=y

# Heap and stacks
CONFIG_HEAP_MEM_POOL_SIZE=16384
CONFIG_MAIN_STACK_SIZE=8192
CONFIG_ADXL362_THREAD_STACK_SIZE=8192
CONFIG_HW_STACK_PROTECTION=y

CONFIG_UART_0_NRF_UARTE=y
CONFIG_UART_0_NRF_FLOW_CONTROL=n

CONFIG_USE_SEGGER_RTT=y
CONFIG_RTT_CONSOLE=y
CONFIG_HAS_SEGGER_RTT=y
CONFIG_USE_SEGGER_RTT=y

CONFIG_JSON_LIBRARY=y

CONFIG_ADXL362=y
CONFIG_ADXL362_TRIGGER_OWN_THREAD=y
CONFIG_ADXL362_ABS_REF_MODE=1
CONFIG_ADXL362_ACTIVITY_THRESHOLD=200
CONFIG_ADXL362_INACTIVITY_THRESHOLD=200
CONFIG_ADXL362_INTERRUPT_MODE=1

CONFIG_ADXL372=y
CONFIG_ADXL372_TRIGGER=y
CONFIG_ADXL362_TRIGGER_OWN_THREAD=y


CONFIG_BOOT_TIME_MEASUREMENT=y
CONFIG_POSIX_CLOCK=y

CONFIG_BASE64=y

CONFIG_HTTP_CLIENT=y
CONFIG_DNS_RESOLVER=y
```

## child_secure_partition_manager.conf
```kconfig
#
# Copyright (c) 2019 Nordic Semiconductor ASA
#
# SPDX-License-Identifier: LicenseRef-BSD-5-Clause-Nordic
#
# Set UARTE1 as non-secure, used for HCI
CONFIG_SPM_NRF_UARTE1_NS=y
CONFIG_SPM_NRF_UARTE2_NS=y
```

## nrf9160_pca20035ns.overlay
```dts
/ {
	chosen {
		zephyr,bt-uart=&uart1;
	};
};

&uart1 {
	current-speed = <1000000>;
	status = "okay";
};

&uart0 {
    rts-pin = <0xFFFFFFFF>;
	cts-pin = <0xFFFFFFFF>;
};
```

## src/main.c
```c
#include <zephyr.h>
#include <lte_lc.h>
#include <modem_info.h>
#include <string.h>
#include <data/json.h>

#include <bluetooth/services/bas.h>
#include "ble.h"
#include "gps.h"
#include "battery_monitor.h"
#include "activity_tracker.h"

#include <logging/log.h>
LOG_MODULE_REGISTER(dog);


static struct modem_param_info modem_param;

static struct gps_data gps_data;

static atomic_t gps_is_active;

struct k_delayed_work gps_stop_work;
struct k_delayed_work gps_start_work;

struct gps_fix {
	int lat_millideg;
	int lon_millideg;
    int alt;
    int acc;
};

static struct json_obj_descr gps_fix_desc[] = {
	JSON_OBJ_DESCR_PRIM(struct gps_fix, lat_millideg, JSON_TOK_NUMBER),
    JSON_OBJ_DESCR_PRIM(struct gps_fix, lon_millideg, JSON_TOK_NUMBER),
    JSON_OBJ_DESCR_PRIM(struct gps_fix, alt, JSON_TOK_NUMBER),
    JSON_OBJ_DESCR_PRIM(struct gps_fix, acc, JSON_TOK_NUMBER)
};

char gps_fix_json[100] = {0};


static void gps_trigger_handler(struct device *dev, struct gps_trigger *trigger)
{
    LOG_INF("GPS triggered");
	ARG_UNUSED(trigger);
	
	gps_sample_fetch(dev);
    gps_channel_get(dev, GPS_CHAN_PVT, &gps_data);

    struct gps_fix gps_fix_info = {
        .lat_millideg = (int)(1000 * gps_data.pvt.latitude),
        .lon_millideg = (int)(1000 * gps_data.pvt.longitude),
        .alt = (int)(gps_data.pvt.altitude),
        .acc = (int)(gps_data.pvt.accuracy),
    };

    int res = json_obj_encode_buf(gps_fix_desc, ARRAY_SIZE(gps_fix_desc), &gps_fix_info, gps_fix_json, sizeof(gps_fix_json));
    if (res) {
        LOG_WRN("Error encoding GPS fix JSON: %d", res);
        return;
    }
    
    LOG_INF("Fix info: %s", gps_fix_json);

    k_delayed_work_submit(&gps_stop_work, K_SECONDS(0));
}

static void gps_stop_handler(struct k_work *work) {
    LOG_INF("Stopping GPS");
    int err = gps_control_stop();
    if (err) {
        LOG_INF("Error stopping GPS: %d", err);
    } else {
        LOG_INF("GPS Stopped");
    }

    atomic_set(&gps_is_active, 0);

    LOG_INF("Sending fix to server: %s", gps_fix_json);

    k_delayed_work_submit(&gps_start_work, K_SECONDS(10));
}

static void gps_start_handler(struct k_work *work) {
    LOG_INF("Starting GPS");
    atomic_set(&gps_is_active, 1);

    LOG_INF("Enabling PSM");
    int err = lte_lc_psm_req(true);
    if (err) {
        LOG_WRN("PSM mode could not be enabled or was already enabled.");
    } else {
        LOG_INF("PSM enabled\n");
    }
    k_sleep(K_SECONDS(1));

    err = gps_control_start();
    if (err) {
        LOG_WRN("Error starting GPS: %d", err);
    }

    k_delayed_work_submit(&gps_stop_work, K_SECONDS(600));
}


void main(void)
{
    LOG_INF("Application started");

    // TODO: Automatically disable when building for qemu
	ble_init();

    bool battery_monitor_valid = false;
    int err = battery_monitor_init();
    if (err) {
        LOG_WRN("Error initializing bttery monitor: %d", err);
    } else {
        battery_monitor_valid = true;
    }

    LOG_INF("Connecting to LTE...");
    err = lte_lc_init_and_connect();
	__ASSERT(err == 0, "LTE link could not be established.");
    LOG_INF("Connected to LTE");

    LOG_INF("Initializing modem info...");
    err = modem_info_init();
    __ASSERT(err == 0, "Modem info could not be inited.");
    LOG_INF("Modem info inited");

    modem_info_params_init(&modem_param);

    LOG_INF("Initializing GPS...");
    gps_control_init(gps_trigger_handler);
    LOG_INF("GPS inited");

    LOG_INF("Initializing activity tracker...");
    err = init_activity_tracker();
    if (err) {
        LOG_WRN("Error initing activity tracker: %d", err);
    } else {
        LOG_INF("Activity tracker ready");
    }
    
    while (true) {
        LOG_INF("Main app loop");

        if (battery_monitor_valid) {
            u8_t battery_percent;
            int ret = battery_monitor_read(&battery_percent);
            if (ret) {
                LOG_WRN("Unable to read battery level: %d", ret);
            } else {
                LOG_INF("Battery level: %d", battery_percent);
                if (battery_percent < 0) {
                    battery_percent = 0;
                }
                if (battery_percent > 100) {
                    battery_percent = 100;
                }
                bt_gatt_bas_set_battery_level((uint16_t)battery_percent);
            }
        }

        if (!atomic_get(&gps_is_active)) {
            int ret = modem_info_params_get(&modem_param);
            if (ret < 0) {
                LOG_WRN("Unable to obtain modem parameters: %d", ret);
            } else {
                LOG_INF("Cell tower information: mcc: %03d mnc: %03d area_code=%d cellid=%u", modem_param.network.mcc.value, modem_param.network.mnc.value, modem_param.network.area_code.value, (unsigned int)modem_param.network.cellid_dec);
                LOG_INF("Cell datetime: %s", modem_param.network.date_time.value_string);
            }
        }

		k_sleep(K_SECONDS(10));
	}
}
```

## src/activity_tracker.c
```c
#include <zephyr.h>
#include <sensor.h>
#include <sys/time.h>

#include "vendor/croaring/roaring.h"

#include "activity_tracker.h"
#include "server_upload.h"

#include <logging/log.h>
LOG_MODULE_REGISTER(act);


static const char* ACCEL_DEVICE_NAME="ADXL362";

static roaring_bitmap_t *periods_with_activity = NULL;
static time_t start_timestamp;
static bool activity_since_upload = true;

K_MUTEX_DEFINE(my_mutex);

#define ACTIVITY_UPLOAD_STACK_SIZE (4096)
K_THREAD_STACK_DEFINE(activity_upload_stack_area, ACTIVITY_UPLOAD_STACK_SIZE);
struct k_work_q activity_upload_q;
struct k_delayed_work activity_uplaod_work;

static const int UPLOAD_INTERVAL = K_SECONDS(5);

static void upload_activity(struct k_work *item) {
    LOG_INF("Uploading activity info");

    k_mutex_lock(&my_mutex, K_FOREVER);

    if (activity_since_upload) {
        activity_since_upload = false;

        report_activity_history(start_timestamp, periods_with_activity);
    }

    k_mutex_unlock(&my_mutex);

    k_delayed_work_submit_to_queue(&activity_upload_q, &activity_uplaod_work, UPLOAD_INTERVAL);
}

static void activity_detected() {
    uint32_t motion_window = (uint32_t)(k_uptime_get() / 1000 - start_timestamp);

	LOG_INF("Motion detected at %u", motion_window);

    k_mutex_lock(&my_mutex, K_FOREVER);

    activity_since_upload = true;

    // TODO: Use one bit per minute, rather than per second, to use less space
    roaring_bitmap_add(periods_with_activity, motion_window);

    k_mutex_unlock(&my_mutex);
}

static void sensor_trigger_handler(struct device *dev,
			struct sensor_trigger *trigger)
{
	ARG_UNUSED(dev);
	ARG_UNUSED(trigger);

    activity_detected();
}

int init_activity_tracker(void) {
    int err = 0;

    start_timestamp = k_uptime_get() / 1000;

    periods_with_activity = roaring_bitmap_create();
    if (!periods_with_activity) {
        LOG_ERR("Unable to create activity bitset");
        // TODO: What can cause this to fail?
        return -ENOMEM;
    }

    struct device *accel_dev = device_get_binding(ACCEL_DEVICE_NAME);
    if (!accel_dev) {
        LOG_ERR("Unable to initialize %s; creating virtual accel", ACCEL_DEVICE_NAME);

        // TODO: Dispatch on a schedule to simulate fun activity
        activity_detected();

        return -ENODEV;
    }


    // TODO: Switch to ADXL372 with lower threshold for improved sensitivity

    struct sensor_trigger sensor_trig = {
        .type = SENSOR_TRIG_THRESHOLD,
    };

    err = sensor_trigger_set(accel_dev, &sensor_trig, sensor_trigger_handler);
    if (err) {
        LOG_ERR("Unable to configure %s trigger: %d", ACCEL_DEVICE_NAME, err);
        return err;
    }

    k_delayed_work_init(&activity_uplaod_work, upload_activity);
    
    k_work_q_start(&activity_upload_q, activity_upload_stack_area, ACTIVITY_UPLOAD_STACK_SIZE, 1);

    k_delayed_work_submit_to_queue(&activity_upload_q, &activity_uplaod_work, UPLOAD_INTERVAL);

    return 0;
}
```

## src/activity_tracker.h
```c
#ifndef ACTIVITY_TRACKER_H_
#define ACTIVITY_TRACKER_H_

int init_activity_tracker(void);

#endif
```

## src/battery_monitor.c
```c
/*
 * Copyright (c) 2019 Nordic Semiconductor ASA
 *
 * SPDX-License-Identifier: LicenseRef-BSD-5-Clause-Nordic
 */

#include <stdbool.h>
#include <string.h>
#include <zephyr.h>
#include <zephyr/types.h>

#include <drivers/adp536x.h>

#include <logging/log.h>
LOG_MODULE_REGISTER(batt);

// TODO: This should pull from a magical constant like DT_NORDIC_NRF_I2C_I2C_2_LABEL
#define ADP536X_I2C_DEV_NAME	        "I2C_2"
#define BATTERY_CHARGE_CAPACITY         0xFF /* Maximum battery capacity. */
#define BATTERY_CHARGE_SLEEP_MODE       true /* Set sleep mode. */

// TODO: Consider increasing/dynamically changing the update rate if it turns out that
// the frequent updates use too much power
#define BATTERY_CHARGE_UPDATE_RATE      0 /* Sample every minute. */

int battery_monitor_init(void)
{
	int ret;

	LOG_INF("Initializing ADP536X");
	ret = adp536x_init(ADP536X_I2C_DEV_NAME);
	if (ret) {
        LOG_WRN("Unable to init ADP536X driver: %d", ret);
		return ret;
	}

	ret = adp536x_bat_cap_set(BATTERY_CHARGE_CAPACITY);
	if (ret) {
		LOG_WRN("Failed to set battery capacity: %d", ret);
		return ret;
	}

	ret = adp536x_fuel_gauge_enable_sleep_mode(BATTERY_CHARGE_SLEEP_MODE);
	if (ret) {
		LOG_WRN("Failed to enable fuel gauge sleep mode: %d", ret);
		return ret;
	}

	ret = adp536x_fuel_gauge_update_rate_set(BATTERY_CHARGE_UPDATE_RATE);
	if (ret) {
		LOG_WRN("Failed to set fuel gauge update rate: %d", ret);
		return ret;
	}

	ret = adp536x_fuel_gauge_set(true);
	if (ret) {
		LOG_WRN("Failed to enable fuel gauge: %d", ret);
		return ret;
	}

    return ret;
}

int battery_monitor_read(u8_t *buf)
{
	return adp536x_bat_soc_read(buf);
}
```

## src/battery_monitor.h
```c
/*
 * Copyright (c) 2019 Nordic Semiconductor ASA
 *
 * SPDX-License-Identifier: LicenseRef-BSD-5-Clause-Nordic
 */
/**@file
 *
 * @defgroup battery_charge Battery Charge
 * @brief  Module that governs the battery charge of the system.
 * @{
 */

#ifndef BATTERY_CHARGE_H__
#define BATTERY_CHARGE_H__

#ifdef __cplusplus
extern "C" {
#endif

/**
 * @brief Init the battery charge monitor module.
 *
 */
int battery_monitor_init(void);

/**
 * @brief Read the current battery charge.
 *
 * @return 0 if the operation was successful, otherwise a (negative) error code.
 */
int battery_monitor_read(u8_t *buf);

#ifdef __cplusplus
}
#endif

#endif /* BATTERY_CHARGE_H__ */
```

## src/ble.c
```c
/*
 * Copyright (c) 2018 Nordic Semiconductor ASA
 *
 * SPDX-License-Identifier: LicenseRef-BSD-5-Clause-Nordic
 */

#include <zephyr.h>

#include <dk_buttons_and_leds.h>
#include <misc/byteorder.h>

#include <nrf_cloud.h>
#include <bluetooth/bluetooth.h>
#include <bluetooth/hci.h>
#include <bluetooth/conn.h>
#include <bluetooth/uuid.h>
#include <bluetooth/gatt.h>
#include <bluetooth/services/bas.h>

static const struct bt_data ad[] = {
	BT_DATA_BYTES(BT_DATA_FLAGS, (BT_LE_AD_GENERAL | BT_LE_AD_NO_BREDR)),
	BT_DATA_BYTES(BT_DATA_UUID16_ALL,
		      0x0b, 0x18, 0x0f, 0x18),
	BT_DATA_BYTES(BT_DATA_UUID128_ALL,
		      0xf0, 0xde, 0xbc, 0x9a, 0x78, 0x56, 0x34, 0x12,
		      0x78, 0x56, 0x34, 0x12, 0x78, 0x56, 0x34, 0x12),
};

static void connected(struct bt_conn *conn, u8_t err)
{
	if (err) {
		printk("Connection failed (err 0x%02x)\n", err);
	} else {
		printk("Connected\n");
	}
}

static void disconnected(struct bt_conn *conn, u8_t reason)
{
	printk("Disconnected (reason 0x%02x)\n", reason);
}

static struct bt_conn_cb conn_callbacks = {
	.connected = connected,
	.disconnected = disconnected,
};

static void bt_ready(int err)
{
	if (err) {
		printk("Bluetooth init failed (err %d)\n", err);
		return;
	}

	printk("Bluetooth initialized\n");

	err = bt_le_adv_start(BT_LE_ADV_CONN_NAME, ad, ARRAY_SIZE(ad), NULL, 0);
	if (err) {
		printk("Advertising failed to start (err %d)\n", err);
		return;
	}

	printk("Advertising successfully started\n");
}

void ble_init(void)
{
	int err;

	printk("Initializing Bluetooth..\n");
	err = bt_enable(bt_ready);
	if (err) {
		printk("Bluetooth init failed (err %d)\n", err);
		return;
	}

	bt_conn_cb_register(&conn_callbacks);
}
```

## src/ble.h
```c
/*
 * Copyright (c) 2018 Nordic Semiconductor ASA
 *
 * SPDX-License-Identifier: LicenseRef-BSD-5-Clause-Nordic
 */

#ifndef _BLE_H_
#define _BLE_H_

void ble_init(void);
void bas_notify(void);

#endif /* _BLE_H_ */
```

## src/gps.c
```c
#include "gps.h"

#include <logging/log.h>
LOG_MODULE_REGISTER(gps);

static struct device *gps_dev = NULL;

int gps_control_init(gps_trigger_handler_t handler)
{
	int err;

	struct gps_trigger gps_trig = {
		.type = GPS_TRIG_FIX,
		.chan = GPS_CHAN_PVT
	};

	gps_dev = device_get_binding("NRF9160_GPS");
	if (gps_dev == NULL) {
		LOG_ERR("Could not get device");
		return -ENODEV;
	}

	err = gps_trigger_set(gps_dev, &gps_trig, handler);
	if (err) {
		LOG_ERR("Could not set trigger, error code: %d", err);
		return err;
	}

	LOG_INF("GPS initialized");

	return 0;
}

int gps_control_start(void) {
    int err = gps_start(gps_dev);
    if (err) {
        LOG_WRN("Error starting GPS: %d", err);
    }

    return err;
}


int gps_control_stop(void)
{
	int err;

    LOG_INF("Disabling PSM");

    err = lte_lc_psm_req(false);
    if (err) {
        LOG_WRN("Unable to disable PSM: %d", err);
    }
    k_sleep(K_SECONDS(1));

    if (!gps_dev) {
        LOG_WRN("Unable to get GPS device");
        return -ENODEV;
    }

	err = gps_stop(gps_dev);
	if (err) {
        LOG_WRN("Unable to stop GPS: %d", err);
		return err;
	}

	return 0;
}
```

## src/gps.h
```c
#ifndef GPS_H_
#define GPS_H_

#include <gps.h>
#include <lte_lc.h>

int gps_control_init(gps_trigger_handler_t handler);
int gps_control_stop(void);
int gps_control_start(void);

#endif
```

## src/server_upload.c
```c
#include "server_upload.h"

#include <net/net_ip.h>
#include <net/socket.h>
#include <pb_encode.h>
#include <logging/log.h>
LOG_MODULE_REGISTER(srv);


#include "dogcollar.pb.h"

// TODO: Externalize config
const char* hostname = "0.tcp.ngrok.io";
const char* port = "18785";


static bool write_roaring_bitmap(pb_ostream_t *stream, const pb_field_iter_t *field, void * const *arg)
{
    size_t bytes_needed_to_serialize = roaring_bitmap_portable_size_in_bytes(*arg);
    char* serialized_activity_bitmap = malloc(bytes_needed_to_serialize);
    if (!serialized_activity_bitmap) {
        LOG_WRN("Unable to allocate memory for serialized activity history");
        return false;
    }
    size_t bytes_serialized = roaring_bitmap_portable_serialize(*arg, serialized_activity_bitmap);
    
    if (bytes_needed_to_serialize != bytes_serialized) {
        LOG_WRN("Error serializing activity history: serialized data should have used %d bytes, but used %d", bytes_needed_to_serialize, bytes_serialized);
        return false;
    }

    bool result = pb_encode_tag_for_field(stream, field) && pb_encode_string(stream, (uint8_t*)serialized_activity_bitmap, bytes_serialized);

    free(serialized_activity_bitmap);

    return result;
}


static int setup_socket(sa_family_t family,
			int *sock, struct addrinfo *addr)
{
	const char *family_str = family == AF_INET ? "IPv4" : "IPv6";
	int ret = 0;

	*sock = socket(family, SOCK_STREAM, IPPROTO_TCP);

	if (*sock < 0) {
		LOG_ERR("Failed to create %s socket (%d)", family_str,
			-errno);
	}

    struct timeval tv;
    tv.tv_sec = 3;
    tv.tv_usec = 0;
    setsockopt(*sock, SOL_SOCKET, SO_RCVTIMEO, (const char*)&tv, sizeof(tv));

	return ret;
}

static int connect_socket(sa_family_t family,
			  int *sock, struct addrinfo *addr)
{
	int ret;

	ret = setup_socket(family, sock, addr);
	if (ret < 0 || *sock < 0) {
		return -1;
	}

	ret = connect(*sock, addr->ai_addr, addr->ai_addrlen);
	if (ret < 0) {
		LOG_ERR("Cannot connect to %s remote (%d)",
			family == AF_INET ? "IPv4" : "IPv6",
			-errno);
		ret = -errno;
	}

	return ret;
}

static bool write_callback(pb_ostream_t *stream, const uint8_t *buf, size_t count)
{
    int fd = (intptr_t)stream->state;

    int remaining = count;
    const uint8_t* current_buf = buf;
    while(remaining > 0) {
        int bytes_written = send(fd, current_buf, remaining, 0);
        if (bytes_written <= 0) {
            LOG_ERR("Error writing protobuf message: %d", bytes_written);
            return false;
        }
        remaining -= bytes_written;
        current_buf += bytes_written;
    }

    return true;
}

pb_ostream_t pb_ostream_from_socket(int fd)
{
    pb_ostream_t stream = {&write_callback, (void*)(intptr_t)fd, SIZE_MAX, 0};
    return stream;
}

int report_activity_history(time_t start_timestamp, roaring_bitmap_t* activity_bitmap) {
    bool bitmap_optimized = roaring_bitmap_run_optimize(activity_bitmap);
    if (bitmap_optimized) {
        LOG_DBG("Optimized activity bitmap");
    }

    LOG_INF("Looking up IP address for %s", hostname);
    static struct addrinfo hints;
	struct addrinfo *res;
    hints.ai_family = AF_INET;
	hints.ai_socktype = SOCK_STREAM;
    

    int ret = getaddrinfo(hostname, port, &hints, &res);
    if (ret) {
        LOG_ERR("Unable to lookup hostname: %d", ret);
        return -EIO;
    }

    int sock4 = -1;
    LOG_INF("Opening socket");
    connect_socket(AF_INET,
				     &sock4, res);
    if (sock4 < 0) {
        LOG_ERR("Unable to connect to server");
        return -EIO;
    }

    Activity activity = Activity_init_zero;
    activity.timestamp = start_timestamp;
    activity.serialized_roaring_bitmap.funcs.encode = &write_roaring_bitmap;
    activity.serialized_roaring_bitmap.arg = activity_bitmap;


    pb_ostream_t output = pb_ostream_from_socket(sock4);
    if (!pb_encode_delimited(&output, Activity_fields, &activity)) {
        LOG_ERR("Unable to write message to server");
    }

    close(sock4);

    LOG_INF("Activity history uploaded");

    return 0;
}
```

## src/server_upload.h
```c
#ifndef SERVER_UPLOAD_H_
#define SERVER_UPLOAD_H_

#include <sys/time.h>
#include "vendor/croaring/roaring.h"

int report_activity_history(time_t start_timestamp, roaring_bitmap_t* activity);

#endif 
```
